## meta-bot/conf/layer.conf
```bitbake
# We have a conf and classes directory, add to BBPATH
BBPATH .= ":${LAYERDIR}"

# We have recipes-* directories, add to BBFILES
BBFILES += "${LAYERDIR}/recipes-*/*/*.bb \
            ${LAYERDIR}/recipes-*/*/*.bbappend"

BBFILE_COLLECTIONS += "meta-bot"
BBFILE_PATTERN_meta-bot = "^${LAYERDIR}/"
BBFILE_PRIORITY_meta-bot = "6"

LAYERDEPENDS_meta-bot = "core"
LAYERSERIES_COMPAT_meta-bot = "kirkstone mickledore"
```
